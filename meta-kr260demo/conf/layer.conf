## meta-mnc-artifact/conf/layer.conf
```bitbake
# Generic Monutchee Station artifact support.
BBPATH .= ":${LAYERDIR}"
MNC_ARTIFACT_LAYERDIR := "${LAYERDIR}"

BBFILES += "${LAYERDIR}/recipes-*/*/*.bb \
            ${LAYERDIR}/recipes-*/*/*.bbappend"

BBFILE_COLLECTIONS += "mnc-artifact"
BBFILE_PATTERN_mnc-artifact = "^${LAYERDIR}/"
BBFILE_PRIORITY_mnc-artifact = "5"

LAYERDEPENDS_mnc-artifact = "core"
LAYERSERIES_COMPAT_mnc-artifact = "scarthgap"
```
