## meta-fpga-util/conf/layer.conf
```bitbake
# We have a conf and classes directory, add to BBPATH
BBPATH .= ":${LAYERDIR}"
FPGA_UTIL_LAYERDIR := "${LAYERDIR}"

# We have recipes-* directories, add to BBFILES
BBFILES += "${LAYERDIR}/recipes-*/*/*.bb \
            ${LAYERDIR}/recipes-*/*/*.bbappend"

BBFILE_COLLECTIONS += "fpga-util"
BBFILE_PATTERN_fpga-util = "^${LAYERDIR}/"
BBFILE_PRIORITY_fpga-util = "5"

LAYERDEPENDS_fpga-util = "core"
LAYERSERIES_COMPAT_fpga-util = "kirkstone langdale scarthgap"
```

## meta-kr260demo/conf/machine/kr260demo.conf
```bitbake
#@TYPE: Machine
#@NAME: kr260demo
#@DESCRIPTION: Monutchee KR260 demo machine using the official KR260 Starter Kit BSP.

# Keep the hardware definition on the AMD/Xilinx Kria KR260 Starter Kit machine.
# This provides the Kria U-Boot defconfig and the KR260 carrier DT overlays
# needed for GEM/PHY/MDIO support.
require conf/machine/k26-smk-kr-sdt.conf
```

## meta-mncos/conf/distro/include/default-features.conf
```bitbake
INIT_MANAGER_MNCOS_DEFAULT = "systemd"
INIT_MANAGER_MNCOS_DEFAULT:zub = "systemd"
INIT_MANAGER_MNCOS_DEFAULT:old = "sysvinit"

INIT_MANAGER_DEFAULT ?= "${INIT_MANAGER_MNCOS_DEFAULT}"

# The user can override INIT_MANAGER by setting INIT_MANAGER_DEFAULT
INIT_MANAGER = "${INIT_MANAGER_DEFAULT}"


#OpenAMP?
```
